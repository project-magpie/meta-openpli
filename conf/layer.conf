## conf/layer.conf
```bitbake
# We have a conf and classes directory, append to BBPATH
BBPATH .= ":${LAYERDIR}"

# We have a recipes directory, add to BBFILES
BBFILES += "${LAYERDIR}/recipes-*/*/*.bb ${LAYERDIR}/recipes-*/*/*.bbappend"

BBFILE_COLLECTIONS += "openpli-layer"
BBFILE_PATTERN_openpli-layer := "^${LAYERDIR}/"
BBFILE_PRIORITY_openpli-layer = "7"

OPENPLI_BASE := "${LAYERDIR}"

# URL definitions
PLISVNURL ?= "svn://svn.code.sf.net/p/openpli/code"
PLISVNPROTO ?= "http"
PLISVNBRANCH ?= "trunk"

# we currently only support spark boxes so exclude the other ones
BBMASK .= "|meta-openpli/recipes-bsp/dreambox"
BBMASK .= "|meta-openpli/recipes-bsp/etx00"
BBMASK .= "|meta-openpli/recipes-bsp/vuplus"
BBMASK .= "|meta-openpli/recipes-bsp/xp"
BBMASK .= "|meta-openpli/recipes-devtools/git"
BBMASK .= "|meta-openpli/recipes-devtools/opkg"
BBMASK .= "|meta-oe/meta-oe/recipes-core/llvm"
BBMASK .= "|meta-openpli/recipes-core/busybox"
```
